## main/Kconfig.projbuild_sample
```kconfig
menu "Clockwork Configuration"

config ESP_WIFI_SSID
    string "WiFi SSID"
    default "myssid"
    help
	SSID (network name) for the example to connect to.

config ESP_WIFI_PASSWORD
    string "WiFi Password"
    default "mypassword"
    help
	WiFi password (WPA or WPA2) for the example to use.
endmenu

config ESP_MQTT_BROKER
    string "MQTT Broker url"
    default "mqtt://localhost:1883"
    help
	The address of the MQTT broker to forward update messages to and receive commands from.
endmenu
```
